## components/audio_player/Kconfig
```kconfig
menu "Coin sound (MAX98357A I2S)"

    config AUDIO_PLAYER_ENABLE
        bool "Play the coin sound on an I2S amplifier"
        default n
        help
            The centralized speaker of the race-timing master (firmware/master;
            its amplifier pins are CONFIG_C6_AUDIO_*). Off by default. Needs
            components/audio_player/sounds/coin.pcm (tools/coin_sound.py). A
            detector (C5) has no amplifier and keeps this off.

endmenu
```

## components/c5vrx_rx/Kconfig.projbuild
```kconfig
menu "C5VRX receiver"

    config C5VRX_VIDEO_OUTPUT
        bool "Drive the 6-bit video DAC (GPIO 23, 24, 11, 12, 8, 9)"
        default y
        help
            Off: the transport (PARLIO TX, BitScrambler) runs unchanged, at the
            same timing, but its bits reach no pin: no picture. The IQ capture
            (MODEM_DIAG -> PARLIO RX) and everything measured from it (C/N,
            gain, FIELD_DIAG) are unaffected. The six DAC pins become free (the
            detector's UART link uses GPIO 8). This fork has no on-screen menu,
            OSD or boot logo either way (menu_stub.c).

endmenu
```

## components/checkpoint/Kconfig
```kconfig
menu "Checkpoint antenna"

    config CHECKPOINT_ANTENNA_IPEX
        bool "Boot on the IPEX antenna (Waveshare ESP32-C5-Zero only)"
        default n
        help
            Drives GPIO 26 high before the radio starts: on the C5-Zero it is the
            antenna switch, high for the IPEX connector, low for the onboard
            antenna. Off, the firmware leaves GPIO 26 alone and the board stays on
            its default, the onboard antenna. Only for a C5-Zero: GPIO 26 is
            something else, or nothing, on other boards. On the bench, K then i
            switches the antenna at run time. A boot with nothing on the IPEX
            connector is deaf; recalibrate (B, VTX off) after changing antenna.

endmenu

menu "Checkpoint C5<->C3 link"

    config CHECKPOINT_LINK_ENABLE
        bool "Enable the UART link to the C3 config/telemetry bridge"
        default y
        help
            Report pass events and stats to, and accept detector configuration
            from, the bridge (a C3 node or the C6 master) over UART. With it
            off, passes appear only as PASS lines on the console, which is then
            the only way to tune the detector (it has no local output).

    config CHECKPOINT_LINK_UART_NUM
        int "UART controller number"
        depends on CHECKPOINT_LINK_ENABLE
        default 1
        range 0 1
        help
            The console is on USB-Serial-JTAG, so UART1 (or UART0) is free.

    config CHECKPOINT_LINK_TX_GPIO
        int "Link UART TX GPIO (to the C3 RX)"
        depends on CHECKPOINT_LINK_ENABLE
        default 6
        help
            GPIO 6 (TX) and 8 (RX) are receiver-free header pins on the
            C5-Zero (GPIO 15 is not broken out). GPIO 8 is a video-DAC pin,
            free with video off. See the GPIO map in CLAUDE.md.

    config CHECKPOINT_LINK_RX_GPIO
        int "Link UART RX GPIO (from the C3 TX)"
        depends on CHECKPOINT_LINK_ENABLE
        default 8

    config CHECKPOINT_LINK_BAUD
        int "Link UART baud rate"
        depends on CHECKPOINT_LINK_ENABLE
        default 115200

    config CHECKPOINT_LINK_STATS_MS
        int "Stats report period (ms)"
        depends on CHECKPOINT_LINK_ENABLE
        default 1000

endmenu
```

## components/status_led/Kconfig
```kconfig
menu "Status LED"

    config STATUS_LED_ENABLE
        bool "Enable the WS2812 status LED"
        default y

    config STATUS_LED_GPIO
        int "WS2812 data GPIO"
        depends on STATUS_LED_ENABLE
        default 29
        help
            Onboard WS2812 on the Waveshare Zero boards: 29 (C5-Zero,
            detector), 10 (C3-Zero, node), 8 (C6-Zero, master). Set the
            right one per firmware in its sdkconfig.defaults.

    config STATUS_LED_BRIGHTNESS
        int "Master brightness (1..255)"
        depends on STATUS_LED_ENABLE
        range 1 255
        default 40
        help
            ~15% of full. A WS2812 at full scale is blinding and draws
            real current; keep it low.

    config STATUS_LED_TICK_MS
        int "Render period (ms)"
        depends on STATUS_LED_ENABLE
        default 50

    config STATUS_LED_STACK
        int "Task stack (bytes)"
        depends on STATUS_LED_ENABLE
        default 2560

endmenu
```

## firmware/c3/main/Kconfig.projbuild
```kconfig
menu "Checkpoint C3 bridge"

    config C3_UART_NUM
        int "Link UART controller number"
        default 1
        range 0 1

    config C3_UART_TX_GPIO
        int "Link UART TX GPIO (to the C5 RX, GPIO 15)"
        default 5

    config C3_UART_RX_GPIO
        int "Link UART RX GPIO (from the C5 TX, GPIO 6)"
        default 4

    config C3_UART_BAUD
        int "Link UART baud rate (must match the C5)"
        default 115200

    config C3_AP_SSID
        string "Wi-Fi SoftAP SSID"
        default "checkpoint-c3"

    config C3_AP_PASSWORD
        string "Wi-Fi SoftAP password (>= 8 chars, empty = open)"
        default "dronepass"

    config C3_AP_CHANNEL
        int "Wi-Fi SoftAP channel"
        default 1
        range 1 13

endmenu
```

## firmware/master/main/Kconfig.projbuild
```kconfig
menu "Checkpoint C6 master"

    comment "UART to the local C5 (link_proto). Defaults assume a C5 on TX6/RX8."
    config C6_UART_NUM
        int "Link UART controller number"
        default 1
        range 0 1
    config C6_UART_TX_GPIO
        int "Link UART TX GPIO (to the local C5 RX)"
        default 4
    config C6_UART_RX_GPIO
        int "Link UART RX GPIO (from the local C5 TX)"
        default 5
    config C6_UART_BAUD
        int "Link UART baud rate (must match the C5)"
        default 115200

    comment "MAX98357A I2S amplifier (the centralized speaker)."
    config C6_AUDIO_BCLK_GPIO
        int "Amplifier BCLK GPIO"
        default 18
    config C6_AUDIO_WS_GPIO
        int "Amplifier LRC (WS) GPIO"
        default 19
    config C6_AUDIO_DOUT_GPIO
        int "Amplifier DIN GPIO"
        default 20
    config C6_AUDIO_SD_GPIO
        int "Amplifier SD GPIO (-1: not driven)"
        default 21

    comment "Wi-Fi SoftAP (admin web + ESP-NOW share this channel)."
    config C6_AP_SSID
        string "Wi-Fi SoftAP SSID"
        default "checkpoint-c6"
    config C6_AP_PASSWORD
        string "Wi-Fi SoftAP password (8 to 63 chars, empty = open)"
        default "dronepass"
    config C6_AP_CHANNEL
        int "Wi-Fi SoftAP / ESP-NOW channel"
        default 1
        range 1 13

    comment "Web roles: spectators read live results; admin actions need this password."
    config C6_ADMIN_PASSWORD
        string "Admin web password (128 bytes max, empty disables admin auth)"
        default "checkpoint"
        help
            Only its salted SHA-256 enters the firmware (main/CMakeLists.txt
            generates admin_hash.h); the build fails above 128 bytes.

    config C6_BOOT_CHIME
        bool "Play the coin sound once at boot (speaker check)"
        default n
        help
            Plays one coin sound at startup to confirm the speaker/amplifier.
            Needs an audio build (Coin sound / CONFIG_AUDIO_PLAYER_ENABLE
            and coin.pcm); it is a no-op otherwise.

endmenu
```

## firmware/node/main/Kconfig.projbuild
```kconfig
menu "Checkpoint C3 bridge"

    config C3_UART_NUM
        int "Link UART controller number"
        default 1
        range 0 1

    config C3_UART_TX_GPIO
        int "Link UART TX GPIO (to the C5 RX, GPIO 8)"
        default 5

    config C3_UART_RX_GPIO
        int "Link UART RX GPIO (from the C5 TX, GPIO 6)"
        default 4

    config C3_UART_BAUD
        int "Link UART baud rate (must match the C5)"
        default 115200

    config C3_AP_SSID
        string "Wi-Fi SoftAP SSID"
        default "checkpoint-c3"

    config C3_AP_PASSWORD
        string "Wi-Fi SoftAP password (8 to 63 chars, empty = open)"
        default "dronepass"

    config C3_AP_CHANNEL
        int "Wi-Fi AP / ESP-NOW channel (must match the C6 master)"
        default 1
        range 1 13

    config C3_FLEET_TIMEOUT_MS
        int "Boot: wait this long for the C6 before degraded mode (ms)"
        default 8000

    comment "Degraded web: spectators read results; changing the band needs this password."
    config C3_ADMIN_PASSWORD
        string "Degraded-web admin password (128 bytes max, empty disables admin auth)"
        default "checkpoint"

endmenu
```

## main/Kconfig.projbuild
```kconfig
menu "C5VRX receiver"

    config C5VRX_VIDEO_OUTPUT
        bool "Drive the 6-bit video DAC (GPIO 23, 24, 11, 12, 8, 9)"
        default y
        help
            Off: the transport (PARLIO TX, BitScrambler) runs unchanged, at the
            same timing, but its bits reach no pin. No picture, no menu on
            screen, no DAC test; the IQ capture (MODEM_DIAG -> PARLIO RX) and
            everything measured from it (C/N, gain, FIELD_DIAG) are unaffected.
            The six DAC pins become free (checkpoint audio).

endmenu
```
